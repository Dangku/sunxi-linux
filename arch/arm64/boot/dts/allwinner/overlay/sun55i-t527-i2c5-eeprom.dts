/dts-v1/;
/plugin/;

/ {
	fragment@0 {
		target = <&twi5>;

		__overlay__ {
			status = "okay";

			at24@50 {
				compatible = "atmel,24c02";
				reg = <0x50>;
				pagesize = <8>;
				//read-only;
			};
		};
	};
};
