/dts-v1/;
/plugin/;

/ {
	fragment@0 {
		target = <&i2s0_plat>;
		__overlay__ {
			status = "okay";
		};
	};

	fragment@1 {
		target = <&i2s0_mach>;
		__overlay__ {
			status = "okay";

			soundcard-mach,capture-only;
		};
	};
};
