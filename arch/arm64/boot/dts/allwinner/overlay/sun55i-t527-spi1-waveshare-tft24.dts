/dts-v1/;
/plugin/;

#include <dt-bindings/gpio/gpio.h>
#include <dt-bindings/gpio/sun4i-gpio.h>

/ {
	fragment@0 {
		target = <&spi1>;
		__overlay__ {
			status = "okay";

			tft24: tft24@0 {
				compatible = "ilitek,ili9341";
				reg = <0>;
				spi-max-frequency = <50000000>;
				rotate = <90>;
				bgr = <0>;
				fps = <30>;
				buswidth = <8>;
				reset-gpios = <&pio PI 7 GPIO_ACTIVE_LOW>;  //phy.22
				dc-gpios = <&pio PB 12 GPIO_ACTIVE_HIGH>;   //phy.18
				led-gpios = <&pio PI 6 GPIO_ACTIVE_HIGH>;   //phy.24
				debug = <0>;
			};
		};
	};
};
