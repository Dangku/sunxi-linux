/dts-v1/;
/plugin/;

#include <dt-bindings/gpio/gpio.h>
#include <dt-bindings/gpio/sun4i-gpio.h>

/ {
	fragment@0 {
		target = <&spi1>;

		__overlay__ {
			status = "okay";

			st7789v@0 {
				status = "okay";
				compatible = "sitronix,st7789v";
				reg = <0>;
				spi-max-frequency = <75000000>;
				rotate = <90>;
				rgb;
				fps = <30>;
				buswidth = <8>;
				reset-gpios = <&pio PI 7 GPIO_ACTIVE_LOW>;  //phy.22
				dc-gpios = <&pio PB 12 GPIO_ACTIVE_HIGH>;    //phy.18
				led-gpios = <&pio PI 6 GPIO_ACTIVE_HIGH>;   //phy.24
				debug = <1>;
			};
		};
	};
};
